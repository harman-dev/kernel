## bxt/arch/x86/configs/xen_guest_defconfig
```kconfig
CONFIG_KPROBES=y
CONFIG_KPROBES_ON_FTRACE=y
CONFIG_UPROBES=y
CONFIG_KRETPROBES=y
CONFIG_USER_RETURN_NOTIFIER=y
CONFIG_PREEMPT_NOTIFIERS=y
# CONFIG_MUTEX_SPIN_ON_OWNER is not set
CONFIG_PARAVIRT=y
# CONFIG_PARAVIRT_DEBUG is not set
# CONFIG_PARAVIRT_SPINLOCKS is not set
CONFIG_XEN=y
CONFIG_XEN_DOM0=y
CONFIG_XEN_PVHVM=y
CONFIG_XEN_512GB=y
CONFIG_XEN_SAVE_RESTORE=y
CONFIG_XEN_DEBUG_FS=y
# CONFIG_XEN_PVH is not set
CONFIG_KVM_GUEST=y
# CONFIG_KVM_DEBUG_FS is not set
CONFIG_PARAVIRT_TIME_ACCOUNTING=y
CONFIG_PARAVIRT_CLOCK=y
CONFIG_X86_MSR=y
CONFIG_MMU_NOTIFIER=y
CONFIG_DEBUG_PANIC_ON_BAD_PAGE=y
CONFIG_HIBERNATE_CALLBACKS=y
CONFIG_PCI_XEN=y
CONFIG_XEN_PCIDEV_FRONTEND=y
# CONFIG_NET_TCPPROBE is not set
CONFIG_SYS_HYPERVISOR=y
CONFIG_XEN_BLKDEV_FRONTEND=y
CONFIG_XEN_BLKDEV_BACKEND=y
# CONFIG_XEN_SCSI_FRONTEND is not set
CONFIG_XEN_NETDEV_FRONTEND=y
CONFIG_XEN_NETDEV_BACKEND=y
CONFIG_INPUT_MOUSEDEV_PSAUX=y
CONFIG_MOUSE_PS2=y
CONFIG_MOUSE_PS2_ALPS=y
CONFIG_MOUSE_PS2_LOGIPS2PP=y
CONFIG_MOUSE_PS2_SYNAPTICS=y
CONFIG_MOUSE_PS2_CYPRESS=y
CONFIG_MOUSE_PS2_LIFEBOOK=y
CONFIG_MOUSE_PS2_TRACKPOINT=y
# CONFIG_MOUSE_PS2_ELANTECH is not set
# CONFIG_MOUSE_PS2_SENTELIC is not set
# CONFIG_MOUSE_PS2_TOUCHKIT is not set
CONFIG_MOUSE_PS2_FOCALTECH=y
CONFIG_MOUSE_PS2_VMMOUSE=y
CONFIG_TOUCHSCREEN_USB_COMPOSITE=m
CONFIG_TOUCHSCREEN_USB_EGALAX=y
CONFIG_TOUCHSCREEN_USB_PANJIT=y
CONFIG_TOUCHSCREEN_USB_3M=y
CONFIG_TOUCHSCREEN_USB_ITM=y
CONFIG_TOUCHSCREEN_USB_ETURBO=y
CONFIG_TOUCHSCREEN_USB_GUNZE=y
CONFIG_TOUCHSCREEN_USB_DMC_TSC10=y
CONFIG_TOUCHSCREEN_USB_IRTOUCH=y
CONFIG_TOUCHSCREEN_USB_IDEALTEK=y
CONFIG_TOUCHSCREEN_USB_GENERAL_TOUCH=y
CONFIG_TOUCHSCREEN_USB_GOTOP=y
CONFIG_TOUCHSCREEN_USB_JASTEC=y
CONFIG_TOUCHSCREEN_USB_ELO=y
CONFIG_TOUCHSCREEN_USB_E2I=y
CONFIG_TOUCHSCREEN_USB_ZYTRONIC=y
CONFIG_TOUCHSCREEN_USB_ETT_TC45USB=y
CONFIG_TOUCHSCREEN_USB_NEXIO=y
CONFIG_TOUCHSCREEN_USB_EASYTOUCH=y
CONFIG_INPUT_XEN_KBDDEV_FRONTEND=y
# CONFIG_INPUT_IDEAPAD_SLIDEBAR is not set
CONFIG_SERIO=y
CONFIG_SERIO_I8042=y
CONFIG_SERIO_SERPORT=y
# CONFIG_SERIO_CT82C710 is not set
# CONFIG_SERIO_PCIPS2 is not set
CONFIG_SERIO_LIBPS2=y
# CONFIG_SERIO_RAW is not set
# CONFIG_SERIO_ALTERA_PS2 is not set
# CONFIG_SERIO_PS2MULT is not set
# CONFIG_SERIO_ARC_PS2 is not set
# CONFIG_USERIO is not set
CONFIG_DEVMEM=y
CONFIG_DEVKMEM=y
CONFIG_HVC_DRIVER=y
CONFIG_HVC_IRQ=y
CONFIG_HVC_XEN=y
CONFIG_HVC_XEN_FRONTEND=y
# CONFIG_TCG_XEN is not set
CONFIG_BOARD_THERMAL=y
CONFIG_AMBIENT_THERMAL=y
CONFIG_FAN_COOLING=y
CONFIG_XEN_WDT=y
CONFIG_VIDEO_TI964=y
CONFIG_FB_DEFERRED_IO=y
CONFIG_XEN_FBDEV_FRONTEND=y
CONFIG_HID_LOGITECH_DJ=y
CONFIG_HID_LOGITECH_HIDPP=y
CONFIG_LOGIRUMBLEPAD2_FF=y
CONFIG_LOGIG940_FF=y
# CONFIG_LEDS_CLEVO_MAIL is not set
CONFIG_IRQ_BYPASS_MANAGER=m

#
# Xen driver support
#
CONFIG_XEN_BALLOON=y
CONFIG_XEN_SCRUB_PAGES=y
CONFIG_XEN_DEV_EVTCHN=m
CONFIG_XEN_BACKEND=y
CONFIG_XENFS=y
CONFIG_XEN_COMPAT_XENFS=y
CONFIG_XEN_SYS_HYPERVISOR=y
CONFIG_XEN_XENBUS_FRONTEND=y
CONFIG_XEN_GNTDEV=m
CONFIG_XEN_GRANT_DEV_ALLOC=m
CONFIG_SWIOTLB_XEN=y
CONFIG_XEN_PCIDEV_BACKEND=y
CONFIG_XEN_PRIVCMD=y
CONFIG_XEN_ACPI_PROCESSOR=m
# CONFIG_XEN_MCE_LOG is not set
CONFIG_XEN_HAVE_PVMMU=y
CONFIG_XEN_EFI=y
CONFIG_XEN_AUTO_XLATE=y
CONFIG_XEN_ACPI=y
CONFIG_XEN_SYMS=y
CONFIG_XEN_HAVE_VPMU=y
# CONFIG_DELL_LAPTOP is not set
# CONFIG_AMILO_RFKILL is not set
# CONFIG_HP_ACCEL is not set
# CONFIG_MSI_LAPTOP is not set
# CONFIG_IDEAPAD_LAPTOP is not set
CONFIG_INTEL_TASKS_DUMP=y
CONFIG_INTEL_TH_EARLY_PRINTK=y
CONFIG_DEBUG_INFO=y
# CONFIG_DEBUG_INFO_REDUCED is not set
# CONFIG_DEBUG_INFO_SPLIT is not set
# CONFIG_DEBUG_INFO_DWARF4 is not set
# CONFIG_GDB_SCRIPTS is not set
CONFIG_DEBUG_KMEMLEAK=y
CONFIG_DEBUG_KMEMLEAK_EARLY_LOG_SIZE=4000
# CONFIG_DEBUG_KMEMLEAK_TEST is not set
CONFIG_DEBUG_KMEMLEAK_DEFAULT_OFF=y
CONFIG_LOCKUP_DETECTOR=y
CONFIG_HARDLOCKUP_DETECTOR_NMI=y
CONFIG_HARDLOCKUP_DETECTOR=y
CONFIG_BOOTPARAM_HARDLOCKUP_PANIC=y
CONFIG_BOOTPARAM_HARDLOCKUP_PANIC_VALUE=1
CONFIG_BOOTPARAM_SOFTLOCKUP_PANIC=y
CONFIG_BOOTPARAM_SOFTLOCKUP_PANIC_VALUE=1
CONFIG_BOOTPARAM_HUNG_TASK_PANIC=y
CONFIG_BOOTPARAM_HUNG_TASK_PANIC_VALUE=1
CONFIG_PANIC_ON_OOPS=y
CONFIG_PANIC_ON_OOPS_VALUE=1
CONFIG_DEBUG_SPINLOCK=y
CONFIG_DEBUG_MUTEXES=y
CONFIG_DEBUG_SG=y
CONFIG_KPROBE_EVENT=y
CONFIG_UPROBE_EVENT=y
CONFIG_PROBE_EVENTS=y
# CONFIG_KPROBES_SANITY_TEST is not set
# CONFIG_STRICT_DEVMEM is not set
# CONFIG_X86_DECODER_SELFTEST is not set
CONFIG_LBR_DUMP_ON_EXCEPTION=y
CONFIG_HAVE_KVM_IRQCHIP=y
CONFIG_HAVE_KVM_IRQFD=y
CONFIG_HAVE_KVM_IRQ_ROUTING=y
CONFIG_HAVE_KVM_EVENTFD=y
CONFIG_KVM_APIC_ARCHITECTURE=y
CONFIG_KVM_MMIO=y
CONFIG_KVM_ASYNC_PF=y
CONFIG_HAVE_KVM_MSI=y
CONFIG_HAVE_KVM_CPU_RELAX_INTERCEPT=y
CONFIG_KVM_VFIO=y
CONFIG_KVM_GENERIC_DIRTYLOG_READ_PROTECT=y
CONFIG_KVM_COMPAT=y
CONFIG_HAVE_KVM_IRQ_BYPASS=y
CONFIG_KVM=m
CONFIG_KVM_INTEL=m
CONFIG_KVM_AMD=m
CONFIG_KVM_MMU_AUDIT=y
CONFIG_KVM_DEVICE_ASSIGNMENT=y
# CONFIG_BOARD_THERMAL is not set
# CONFIG_AMBIENT_THERMAL is not set
# CONFIG_FAN_COOLING is not set
```

## bxt/drivers/harman/Kconfig
```kconfig
menu "Device Harman Drivers"

config HARMAN_DRIVERS
	tristate "HARMAN_DRIVERS"

source "drivers/harman/dabplugin/Kconfig"
source "drivers/harman/dynamic_spi_node/Kconfig"
source "drivers/harman/lvsd/Kconfig"

endmenu
```

## bxt/drivers/harman/dabplugin/Kconfig
```kconfig
#
# SPI DAB Plugin
#
config SPI_DAB_PLUGIN
	tristate "SPI DAB PLUGIN SUPPORT"
	depends on SPI && HARMAN_DRIVERS
	help
		Special DAB plugin
```

## bxt/drivers/harman/dynamic_spi_node/Kconfig
```kconfig
#
# SPI dynamic Driver
#
config SPI_DYNAMIC_NODE
       tristate "SPI DYNAMIC SLAVE SUPPORT"
       depends on SPI && HARMAN_DRIVERS && SPI_DAB_PLUGIN
       help
	Driver handles the platform data registration
	for SPI slave devices dynamically. It only supports
	DAB  and spidev on bus num 1 with CS 1.
```

## bxt/drivers/harman/lvsd/Kconfig
```kconfig
config HARMAN_LVSD
	tristate "Harman Linux Virtual Serial Driver for Mountpoints"
	default m
        help
	This driver creates a /dev/ctrlX Character Driver device file,
	which is used to Wicome's VSAL Layer, to create artificial mount
	points like /dev/btspp1(LVSD Mount Point) etc., when requested by Projects application software for SPP profile.
	This is a requirement for GM Project. Which will use the LVSD mount point to transfer data from BT phone to application and
	vice versa, via BT-SPP profile.
```

## bxt/drivers/video/gm-serdes/Kconfig
```kconfig
menu "GM Display Serdes Drivers"

config GM_DISPLAY_SERDES
        tristate "GM DISPLAY SERDES DRIVERS"
endmenu
```

## modules/intel_fm/Kconfig
```kconfig
#Kconfig
#
# Intel FM Radio Adapters
#
menu "Intel FM Radio Adapters"

config RADIO_INTEL
        tristate "Intel FM Radio Adapter Support"
	depends on INTEL_LD
        depends on VIDEO_V4L2
        ---help---
           Choose Y here if you have this FM radio driver.

           In order to control your radio card, you will need to use programs
           that are compatible with the Video For Linux 2 API.  Information on
           this API and pointers to "v4l2" programs may be found at
           <file:Documentation/video4linux/API.html>.

           To compile this driver as a module, choose M here: the
           module will be called fmdrv_intel.

if RADIO_INTEL && !RADIO_I8X70
comment "Select Any one FM Radio Adaptor"
endif

config RADIO_I8X70
        bool "Support for FM Receiver on Intel Connectivity chip (I8X70 - LnP)"
        depends on RADIO_INTEL
endmenu
```
